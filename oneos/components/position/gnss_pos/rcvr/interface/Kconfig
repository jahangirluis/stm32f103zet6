## oneos/components/position/gnss_pos/rcvr/interface/Kconfig
```kconfig
menu "gnss receiver operation"

	if GNSS_USING_RCVR
		config ONEPOS_RCVR_DEBUG
			bool "enable gnss receiver debug"
			default n
	
		config RCVR_SUPP_PROT
			bool "gnss receiver using protocol"
			select GNSS_USING_PROT
			default n
			
		config RCVR_SUPP_RESET
			bool "gnss receiver support reset operation"
			default n
	endif
	
endmenu
	
```

## oneos/components/position/net_pos/Kconfig
```kconfig
menu "network positon"
	
	config ONEPOS_USING_NET_POS
	bool "enable network positon"
	select ONEPOS_USING_PROT
	default n
	
	if ONEPOS_USING_NET_POS
		source "$OS_ROOT/components/position/net_pos/*/Kconfig"
	endif
	
endmenu
```

## oneos/components/position/net_pos/interface/Kconfig
```kconfig
menu "network positon"

	config NET_POS_DEV_REC_POS
		bool "enable device receive position result"
		default n
	
	config ONEPOS_NET_POS_DEBUG
		bool "enable network position debug"
		default n
	
	config NET_POS_SUPP_REMOTE_CONF
		bool "enable remote config"
		default n
	
		if NET_POS_DEV_REC_POS
			config REC_POS_TIMEOUT
				int "timeout while device receive position result(ms)"
				range 2900 65535
				default 2900
		endif
	
	config NET_POS_DEF_INTERVAL
		int "interval of OnePos(should 3 or over)(s)"
		range 3 65535
		default 3	

	config NET_POS_DEF_SEV_TYPE
		int "default position server run type(0:period ciculation;1:single)"
		range 0 1
		default 0
endmenu
```

## oneos/components/position/prot/Kconfig
```kconfig
menu "onepos protocol"

config ONEPOS_USING_PROT
    bool "enable onepos communication protocol"
    default n

if ONEPOS_USING_PROT
	config ONEPOS_PROTO_DEBUG
		bool "enable onepos protocol debug"
		default n
		
	config ONEPOS_DEVICE_ID
		string "device ID by onepos platform alloted"
	
	config ONEPOS_PASSWORD
		string "password by onepos platform alloted"
	
	config ONEPOS_COMM_REC_BUFF_LEN
		int "receive buff size of OnePos communication(bytes)"
		default 2048
	
	config ONEPOS_COMM_SEND_BUFF_LEN
		int "send buff size of OnePos communication(bytes)"
		default 2048
	
endif

endmenu 
```
